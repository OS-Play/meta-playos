## conf/bblayers.conf.sample
```bitbake
# POKY_BBLAYERS_CONF_VERSION is increased each time build/conf/bblayers.conf
# changes incompatibly
POKY_BBLAYERS_CONF_VERSION = "2"



BBPATH = "${TOPDIR}/"
BBFILES ?= ""

BBLAYERS ?= " \
  ##OEROOT##/meta \
  ##OEROOT##/../3rdparty/meta-meson \
  ##OEROOT##/../3rdparty/meta-openembedded/meta-oe \
  ##OEROOT##/../3rdparty/meta-openembedded/meta-multimedia \
  ##OEROOT##/../3rdparty/meta-openembedded/meta-networking \
  ##OEROOT##/../3rdparty/meta-openembedded/meta-python \
  ##OEROOT##/../meta-bsp \
  ##OEROOT##/../meta-library \
  ##OEROOT##/../meta-services \
  ##OEROOT##/../meta-apps \
  ##OEROOT##/../meta-retroarch \
  ##OEROOT##/../meta-playos \
  "
```

## conf/distro/playos.conf
```bitbake
DISTRO = "playos"
DISTRO_NAME = "PlayOS"
DISTRO_VERSION = "0.1.0"
DISTRO_CODENAME = "hardknott"
SDK_VENDOR = "-playossdk"
SDK_VERSION = "${@d.getVar('DISTRO_VERSION').replace('snapshot-${DATE}', 'snapshot')}"

MAINTAINER = "Rany <rany@playos.xyz>"

TARGET_VENDOR = "-playos"
TCLIBC = "musl"

LOCALCONF_VERSION = "1"

DISTRO_VERSION[vardepsexclude] = "DATE"
SDK_VERSION[vardepsexclude] = "DATE"

LICENSE_FLAGS_ACCEPTED = "commercial_ffmpeg"

# # Override these in playos based distros
PLAYOS_DEFAULT_DISTRO_FEATURES = "\
    largefile \
    opengl \
    ptest \
    multiarch \
    wayland \
    vulkan \
    pam \
    openrc \
    packagegroup-coreui \
    usrmerge \
    usbgadget \
    bluetooth \
    wifi \
    "
# For RetroArch
PLAYOS_DEFAULT_DISTRO_EXTRA_FEATURES = "\
        retroarch-gles \
        "
RETROARCH_DEFAULT_MENU_DRIVER = "xmb"

PLAYOS_DEFAULT_EXTRA_RDEPENDS = "packagegroup-core-boot"
DISTRO_FEATURES_DEFAULT:remove = " x11"

DISTRO_FEATURES ?= "${DISTRO_FEATURES_DEFAULT} \
                    ${PLAYOS_DEFAULT_DISTRO_FEATURES} \
                    ${PLAYOS_DEFAULT_DISTRO_EXTRA_FEATURES}"
DISTRO_EXTRA_RDEPENDS += " ${PLAYOS_DEFAULT_EXTRA_RDEPENDS}"

SDK_NAME = "${DISTRO}-${TCLIBC}-${SDKMACHINE}-${IMAGE_BASENAME}-${TUNE_PKGARCH}-${MACHINE}"
SDKPATH = "/opt/${DISTRO}/${SDK_VERSION}"
SDKIMAGE_FEATURES += "staticdev-pkgs"

# PREFERRED_VERSION_linux-yocto ?= "5.4%"


TOOLCHAIN_HOST_TASK:append = " nativesdk-flutter"


DISTRO_FEATURES_BACKFILL_CONSIDERED:append = " systemd busybox sysvinit"
VIRTUAL-RUNTIME_init_manager = "openrc"
VIRTUAL-RUNTIME_initscripts = "openrc"
VIRTUAL-RUNTIME_login_manager = "openrc"

PLAYOSQEMUDEPS = "${@bb.utils.contains("INCOMPATIBLE_LICENSE", "GPL-3.0", "", "packagegroup-core-device-devel",d)}"
DISTRO_EXTRA_RDEPENDS:append:qemuarm = " ${PLAYOSQEMUDEPS}"
DISTRO_EXTRA_RDEPENDS:append:qemuarm64 = " ${PLAYOSQEMUDEPS}"
DISTRO_EXTRA_RDEPENDS:append:qemumips = " ${PLAYOSQEMUDEPS}"
DISTRO_EXTRA_RDEPENDS:append:qemuppc = " ${PLAYOSQEMUDEPS}"
DISTRO_EXTRA_RDEPENDS:append:qemux86 = " ${PLAYOSQEMUDEPS}"
DISTRO_EXTRA_RDEPENDS:append:qemux86-64 = " ${PLAYOSQEMUDEPS}"

# PREMIRRORS ??= "\
# bzr://.*/.*   http://downloads.yoctoproject.org/mirror/sources/ \n \
# cvs://.*/.*   http://downloads.yoctoproject.org/mirror/sources/ \n \
# git://.*/.*   http://downloads.yoctoproject.org/mirror/sources/ \n \
# gitsm://.*/.* http://downloads.yoctoproject.org/mirror/sources/ \n \
# hg://.*/.*    http://downloads.yoctoproject.org/mirror/sources/ \n \
# osc://.*/.*   http://downloads.yoctoproject.org/mirror/sources/ \n \
# p4://.*/.*    http://downloads.yoctoproject.org/mirror/sources/ \n \
# svn://.*/.*   http://downloads.yoctoproject.org/mirror/sources/ \n"

SANITY_TESTED_DISTROS ?= " \
            ubuntu-16.04 \n \
            ubuntu-18.04 \n \
            ubuntu-19.04 \n \
            ubuntu-20.04 \n \
            fedora-30 \n \
            fedora-31 \n \
            fedora-32 \n \
            centos-7 \n \
            centos-8 \n \
            debian-8 \n \
            debian-9 \n \
            debian-10 \n \
            opensuseleap-15.1 \n \
            "
# #
# # OELAYOUT_ABI allows us to notify users when the format of TMPDIR changes in
# # an incompatible way. Such changes should usually be detailed in the commit
# # that breaks the format and have been previously discussed on the mailing list
# # with general agreement from the core team.
# #
OELAYOUT_ABI = "15"

# add playos sanity bbclass
# INHERIT += "playos-sanity"

require conf/distro/include/yocto-uninative.inc
require conf/distro/include/security_flags.inc
INHERIT += "uninative"

# INHERIT += "reproducible_build"

BB_SIGNATURE_HANDLER ?= "OEEquivHash"
BB_HASHSERVE ??= "auto"

VOLATILE_LOG_DIR = "yes"
VOLATILE_TMP_DIR = "yes"
```

## conf/layer.conf
```bitbake
# We have a conf and classes directory, add to BBPATH
BBPATH .= ":${LAYERDIR}"

# We have recipes-* directories, add to BBFILES
BBFILES += "${LAYERDIR}/recipes-*/*/*.bb \
            ${LAYERDIR}/recipes-*/*/*.bbappend"

BBFILE_COLLECTIONS += "playos"
BBFILE_PATTERN_playos = "^${LAYERDIR}/"
BBFILE_PRIORITY_playos = "6"

LAYERDEPENDS_playos = "core"
LAYERSERIES_COMPAT_playos = "kirkstone"

# FIXME: remove this package, use the package from meta-oe
BBMASK += "meta-playos/recipes-extended/libexecinfo/libexecinfo \
          "
```
